## conf/machine/orion.conf
```bitbake
# ============================================================================
#  Orion - Cronos Hardware v2 - Machine Configuration
#  Target: Orange Pi 5 Plus (RK3588)
#  Custom machine definition for Cronos distribution
# ============================================================================

# Base SoC/machine settings from Rockchip RK3588
require conf/machine/include/rk3588.inc

MACHINEOVERRIDES .= ":orangepi-5-plus"

MACHINE_VERSION = "2.0"
# ----------------------------------------------------------------------------
#  Kernel configuration
# ----------------------------------------------------------------------------

# Prefer upstream Yocto-based kernel unless Cronos has its own kernel later
PREFERRED_PROVIDER_virtual/kernel = "linux-yocto-dev"

# Device Tree for Orange Pi 5 Plus
KERNEL_DEVICETREE = "rockchip/rk3588-orangepi-5-plus.dtb"

# Include all kernel modules by default
MACHINE_EXTRA_RRECOMMENDS += "kernel-modules"

# ----------------------------------------------------------------------------
#  U-Boot configuration
# ----------------------------------------------------------------------------

UBOOT_MACHINE = "orangepi-5-plus-rk3588_defconfig"

# ----------------------------------------------------------------------------
#  Machine identity
# ----------------------------------------------------------------------------

MACHINE_FEATURES += "screen ethernet wifi bluetooth usb host drm"

# Storage
IMAGE_FSTYPES += "tar.gz ext4"
```
