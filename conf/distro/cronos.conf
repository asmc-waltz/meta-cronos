## conf/distro/cronos.conf
```bitbake
# ============================================================================
#  Cronos Distro Configuration
#  A lightweight, modern, systemd-based embedded Linux distribution
#  for Cronos hardware v2 (Orange Pi 5 Plus)
# ============================================================================
#  Distro identity
# ----------------------------------------------------------------------------
DISTRO = "cronos"
DISTRO_NAME = "Cronos Embedded Multifunction Distro"
DISTRO_VERSION = "1.0"
DISTRO_CODENAME = "orion-alpha"

SDK_VENDOR = "-cronos"
TARGET_VENDOR = "-cronos"

CRONOS_DEFAULT_DISTRO_FEATURES = ""
DISTRO_FEATURES ?= "${DISTRO_FEATURES_DEFAULTS} ${CRONOS_DEFAULT_DISTRO_FEATURES}"

DISTRO_EXTRA_RDEPENDS += "packagegroup-core-boot"
DISTRO_EXTRA_RRECOMMENDS += "kernel-module-af-packet"

SDK_NAME = "${DISTRO}-${TCLIBC}-${SDKMACHINE}-${IMAGE_BASENAME}-${TUNE_PKGARCH}-${MACHINE}"
SDKPATHINSTALL = "/opt/${DISTRO}/${SDK_VERSION}"

require conf/distro/include/no-static-libs.inc
require conf/distro/include/yocto-uninative.inc
require conf/distro/include/security_flags.inc
require conf/distro/include/yocto-space-optimize.inc
INHERIT += "uninative"

BB_SIGNATURE_HANDLER ?= "OEEquivHash"
BB_HASHSERVE ??= "auto"

# ----------------------------------------------------------------------------
#  Package management backend
# ----------------------------------------------------------------------------
PACKAGE_CLASSES = "package_ipk"

# ----------------------------------------------------------------------------
#  Init system & system configuration
# ----------------------------------------------------------------------------
DISTRO_FEATURES:append = " systemd usrmerge"
DISTRO_FEATURES:remove = " sysvinit"
INIT_MANAGER = "systemd"

# We need debug symbols so that SPDX license manifests for the kernel work
KERNEL_EXTRA_FEATURES:append = " features/debug/debug-kernel.scc"

# Enable creation of SPDX manifests by default
INHERIT += "create-spdx"
```
